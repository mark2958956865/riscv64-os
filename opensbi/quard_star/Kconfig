## opensbi/quard_star/Kconfig
```kconfig
# SPDX-License-Identifier: BSD-2-Clause

config PLATFORM_QUARD_STAR
    bool
    select FDT
    select FDT_DOMAIN
    select FDT_PMU

    select FDT_SERIAL
    select FDT_SERIAL_UART8250

    select FDT_IPI
    select FDT_IPI_MSWI

    select FDT_TIMER
    select FDT_TIMER_MTIMER

    default y
```

## opensbi/quard_star/configs/defconfig
```kconfig
CONFIG_PLATFORM_ALLWINNER_D1=y​
2CONFIG_PLATFORM_ANDES_AE350=y​
3CONFIG_PLATFORM_RENESAS_RZFIVE=y​
4CONFIG_PLATFORM_SIFIVE_FU540=y​
5CONFIG_PLATFORM_SIFIVE_FU740=y​
6CONFIG_FDT_GPIO=y​
7CONFIG_FDT_GPIO_SIFIVE=y​
8CONFIG_FDT_I2C=y​
9CONFIG_FDT_I2C_SIFIVE=y​
10CONFIG_FDT_IPI=y​
11CONFIG_FDT_IPI_MSWI=y​
12CONFIG_FDT_IPI_PLICSW=y​
13CONFIG_FDT_IRQCHIP=y​
14CONFIG_FDT_IRQCHIP_APLIC=y​
15CONFIG_FDT_IRQCHIP_IMSIC=y​
16CONFIG_FDT_IRQCHIP_PLIC=y​
17CONFIG_FDT_RESET=y​
18CONFIG_FDT_RESET_ATCWDT200=y​
19CONFIG_FDT_RESET_GPIO=y​
20CONFIG_FDT_RESET_HTIF=y​
21CONFIG_FDT_RESET_SIFIVE_TEST=y​
22CONFIG_FDT_RESET_SUNXI_WDT=y​
23CONFIG_FDT_RESET_THEAD=y​
24CONFIG_FDT_SERIAL=y​
25CONFIG_FDT_SERIAL_CADENCE=y​
26CONFIG_FDT_SERIAL_GAISLER=y​
27CONFIG_FDT_SERIAL_HTIF=y​
28CONFIG_FDT_SERIAL_RENESAS_SCIF=y​
29CONFIG_FDT_SERIAL_SHAKTI=y​
30CONFIG_FDT_SERIAL_SIFIVE=y​
31CONFIG_FDT_SERIAL_LITEX=y​
32CONFIG_FDT_SERIAL_UART8250=y​
33CONFIG_FDT_SERIAL_XILINX_UARTLITE=y​
34CONFIG_FDT_TIMER=y​
35CONFIG_FDT_TIMER_MTIMER=y​
36CONFIG_FDT_TIMER_PLMT=y​
37CONFIG_SERIAL_SEMIHOSTING=y
```
